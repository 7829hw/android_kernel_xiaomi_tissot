## techpack/Kconfig
```kconfig
menu "Tech packages"

source "techpack/data/Kconfig"

endmenu

source "techpack/camera-legacy/Kconfig"
source "techpack/xiaomi-msm8953/Kconfig"
```

## techpack/camera-legacy/Kconfig
```kconfig
menu "Camera (Legacy)"

config MSMB_CAMERA_LEGACY
	bool "Qualcomm MSM camera and video capture 2.0 support (Legacy)"
	depends on ARCH_MSM8953
	select MSM_AVTIMER
	select MSMB_CAMERA
	help
	---help---
	  Say Y here to enable selecting the video adapters for
	  Qualcomm msm camera and video capture 2.0, enabling this
	  adds support for the camera driver stack including sensor, isp
	  and postprocessing drivers. (Legacy)

endmenu

config MSM_AVTIMER
	bool
	help
	  Enable the legacy ISP callback interface to the audio AVTimer.
```

## techpack/xiaomi-msm8953/Kconfig
```kconfig
config MACH_XIAOMI_MSM8953
	bool "Support for Xiaomi MSM8953 platform"
	depends on ARCH_MSM8953
	help
	  Say Y here to enable support for Xiaomi MSM8953 platform.

if MACH_XIAOMI_MSM8953

source "techpack/xiaomi-msm8953/mach/Kconfig"
source "techpack/xiaomi-msm8953/pmic/Kconfig"
source "techpack/xiaomi-msm8953/touchscreen/Kconfig"
source "techpack/xiaomi-msm8953/leds/Kconfig"
source "techpack/xiaomi-msm8953/ir/Kconfig"
source "techpack/xiaomi-msm8953/fingerprint/Kconfig"
source "techpack/xiaomi-msm8953/vibrator/Kconfig"

endif
```

## techpack/xiaomi-msm8953/ir/Kconfig
```kconfig
config SPI_PEELIR
	tristate "Peel infrared transmitter"
	depends on SPI
	help
	  Enable the SPI infrared transmitter used by Xiaomi Mi A1.
```

## techpack/xiaomi-msm8953/touchscreen/Kconfig
```kconfig
source "techpack/xiaomi-msm8953/touchscreen/focaltech_touch/Kconfig"

config TOUCHSCREEN_SYSCTL_MI8953
	bool "Sysctl control interface for Xiaomi MSM8953 touchscreens"
	depends on INPUT_TOUCHSCREEN && SYSCTL
	help
	  Enable the Xiaomi MSM8953 touchscreen control interface.
```
